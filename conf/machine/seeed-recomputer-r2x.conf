## conf/machine/seeed-recomputer-r2x.conf
```bitbake
#@TYPE: Machine
#@NAME: Seeed reComputer-R2x
#@SOC: broadcom bcm2712
#@DESCRIPTION: Machine configuration for seeed reComputer-R2x

require conf/machine/raspberrypi5.conf

RPI_KERNEL_DEVICETREE_OVERLAYS:append = " overlays/reComputer-R2x.dtbo overlays/reComputer-R21.dtbo"
ENABLE_UART = "1"

# Essential packages for reComputer R2x
MACHINE_ESSENTIAL_EXTRA_RRECOMMENDS += "recomputer-r2x-detection seeed-linux-dtoverlays"

# Override userlandtools compatibility for this machine
COMPATIBLE_MACHINE:pn-userlandtools = "seeed-recomputer-r2x"
```
